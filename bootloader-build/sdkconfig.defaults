## bootloader-build/sdkconfig.defaults
```kconfig
CONFIG_IDF_TARGET="esp32s3"
CONFIG_SECURE_BOOT=y
CONFIG_SECURE_BOOT_V2_ENABLED=y
CONFIG_SECURE_BOOT_SIGNING_KEY="/Users/berni/Projects/CriticalInfrastructure/keys/secure_boot_signing_key.pem"
CONFIG_SECURE_BOOT_BUILD_SIGNED_BINARIES=y
CONFIG_SECURE_FLASH_ENC_ENABLED=y
CONFIG_SECURE_FLASH_ENCRYPTION_MODE_DEVELOPMENT=y
CONFIG_PARTITION_TABLE_OFFSET=0x10000
```

## secure-boot/sdkconfig.defaults
```kconfig
# Secure Boot v2, external (HSM) signing — validated with ESP-IDF v5.5.4.
# `idf.py bootloader` produces a secure-padded, UNSIGNED bootloader that we sign
# afterwards with sign-secure-boot.sh (Token2 primary + Thetis backup).
CONFIG_IDF_TARGET="esp32s3"
CONFIG_SECURE_BOOT=y
CONFIG_SECURE_BOOT_V2_ENABLED=y
CONFIG_SECURE_BOOT_BUILD_SIGNED_BINARIES=n
CONFIG_SECURE_BOOT_ENABLE_AGGRESSIVE_KEY_REVOKE=n

# Flash encryption (4.5). The bootloader encrypts flash in place on first boot and
# auto-generates + burns the XTS-AES key. AES-256 (512-bit) uses two free key blocks
# (KEY3/KEY4; KEY0=HMAC identity, KEY1/2=secure-boot digests). DEVELOPMENT mode keeps a
# recovery path (UART can still write plaintext, which the bootloader re-encrypts);
# switch to RELEASE only after validating OTA under encryption. See docs/formal/OTA.md.
CONFIG_SECURE_FLASH_ENC_ENABLED=y
CONFIG_SECURE_FLASH_ENCRYPTION_AES256=y
CONFIG_SECURE_FLASH_ENCRYPTION_MODE_DEVELOPMENT=y

# The secure-boot bootloader is ~0x9000 bytes and overruns the default 0x8000
# partition-table offset — bump it (shifts the whole flash layout; the app in
# Phase B must match this partition table).
CONFIG_PARTITION_TABLE_OFFSET=0xc000

# A/B OTA: two app slots + otadata, with anti-brick rollback (the bootloader
# reverts to the previous slot if a new image doesn't confirm itself Valid on
# first boot). The custom table is partitions.csv; the app reads it at runtime via
# esp-bootloader-esp-idf. See docs/formal/OTA.md.
CONFIG_PARTITION_TABLE_CUSTOM=y
CONFIG_PARTITION_TABLE_CUSTOM_FILENAME="partitions.csv"
CONFIG_BOOTLOADER_APP_ROLLBACK_ENABLE=y

# The A/B table ends at ~0x410000 (4.1 MB), so the project flash size must be >= 8 MB
# or idf.py's partition-table fit-check fails (default is 2 MB). 8 MB is the minimum
# that fits and is portable to any >= 8 MB board (our spare is 16 MB).
CONFIG_ESPTOOLPY_FLASHSIZE_8MB=y
CONFIG_ESPTOOLPY_FLASHSIZE="8MB"
```
